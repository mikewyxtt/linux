## drivers/phy/apple/Kconfig
```kconfig
# SPDX-License-Identifier: GPL-2.0 OR BSD-2-Clause
config PHY_APPLE_ATC
	tristate "Apple Type-C PHY"
	depends on ARCH_APPLE || COMPILE_TEST
	default ARCH_APPLE
	select GENERIC_PHY
	select TYPEC
	help
	  Enable this to add support for the Apple Type-C PHY, switch
	  and mux found in Apple SoCs such as the M1.
	  This driver currently provides support for USB2 and USB3.

config PHY_APPLE_ATC_CROSSBAR
	tristate "Apple Type-C PHY Display crossbar
	depends on ARCH_APPLE || COMPILE_TEST
	default ARCH_APPLE
	select MULTIPLEXER
	help
	  Enable this to add support the Type-C PHY's display crossbar used to
	  route dispaly controller streams to the Type-C ports.

	  To compile this driver as a module, chose M here: the module will be
	  called phy-apple-atc-display-crossbar.
```

## drivers/soc/apple/Kconfig
```kconfig
# SPDX-License-Identifier: GPL-2.0-only

if ARCH_APPLE || COMPILE_TEST

menu "Apple SoC drivers"

config APPLE_PMGR_PWRSTATE
	bool "Apple SoC PMGR power state control"
	depends on PM
	select REGMAP
	select MFD_SYSCON
	select PM_GENERIC_DOMAINS
	select RESET_CONTROLLER
	default ARCH_APPLE
	help
	  The PMGR block in Apple SoCs provides high-level power state
	  controls for SoC devices. This driver manages them through the
	  generic power domain framework, and also provides reset support.

config APPLE_RTKIT
	tristate "Apple RTKit co-processor IPC protocol"
	depends on ARCH_APPLE || COMPILE_TEST
	select MAILBOX # depend creates cycle with RUST_APPLE_RTKIT
	default ARCH_APPLE
	help
	  Apple SoCs such as the M1 come with various co-processors running
	  their proprietary RTKit operating system. This option enables support
	  for the protocol library used to communicate with those. It is used
	  by various client drivers.

	  Say 'y' here if you have an Apple SoC.

# Rust abstractions cannot be built as modules currently, so force them as
# bool by using these intermediate options. In the future these could be
# tristate once abstractions themselves can be built as modules.
config RUST_APPLE_RTKIT
	bool "Rust support"
	depends on APPLE_RTKIT=y
	default ARCH_APPLE if APPLE_RTKIT=y

config APPLE_SART
	tristate "Apple SART DMA address filter"
	depends on ARCH_APPLE || COMPILE_TEST
	default ARCH_APPLE
	help
	  Apple SART is a simple DMA address filter used on Apple SoCs such
	  as the M1. It is usually required for the NVMe coprocessor which does
	  not use a proper IOMMU.

	  Say 'y' here if you have an Apple SoC.

endmenu

endif
```
